## Documentation/devicetree/bindings/cpufreq/kryo-cpufreq.txt
```
Qualcomm Technologies, Inc. KRYO CPUFreq and OPP bindings
===================================

In Certain Qualcomm Technologies, Inc. SoCs like apq8096 and msm8996
that have KRYO processors, the CPU ferequencies subset and voltage value
of each OPP varies based on the silicon variant in use.
Qualcomm Technologies, Inc. Process Voltage Scaling Tables
defines the voltage and frequency value based on the msm-id in SMEM
and speedbin blown in the efuse combination.
The qcom-cpufreq-kryo driver reads the msm-id and efuse value from the SoC
to provide the OPP framework with required information.
This is used to determine the voltage and frequency value for each OPP of
operating-points-v2 table when it is parsed by the OPP framework.

Required properties:
--------------------
In 'cpus' nodes:
- operating-points-v2: Phandle to the operating-points-v2 table to use.

In 'operating-points-v2' table:
- compatible: Should be
	- 'operating-points-v2-kryo-cpu' for apq8096 and msm8996.
- nvmem-cells: A phandle pointing to a nvmem-cells node representing the
		efuse registers that has information about the
		speedbin that is used to select the right frequency/voltage
		value pair.
		Please refer the for nvmem-cells
		bindings Documentation/devicetree/bindings/nvmem/nvmem.txt
		and also examples below.
Example 1:
---------

cpus {
	#address-cells = <2>;
	#size-cells = <0>;

	CPU0: cpu@0 {
		device_type = "cpu";
		compatible = "qcom,kryo";
		reg = <0x0 0x0>;
		enable-method = "psci";
		clocks = <&kryocc 0>;
		operating-points-v2 = <&cluster0_opp>;
		cooling-min-level = <0>;
		cooling-max-level = <15>;
		#cooling-cells = <2>;
		next-level-cache = <&L2_0>;
		L2_0: l2-cache {
		      compatible = "cache";
		      cache-level = <2>;
		};
	};

	CPU1: cpu@1 {
		device_type = "cpu";
		compatible = "qcom,kryo";
		reg = <0x0 0x1>;
		enable-method = "psci";
		clocks = <&kryocc 0>;
		operating-points-v2 = <&cluster0_opp>;
		cooling-min-level = <0>;
		cooling-max-level = <15>;
		#cooling-cells = <2>;
		next-level-cache = <&L2_0>;
	};

	CPU2: cpu@100 {
		device_type = "cpu";
		compatible = "qcom,kryo";
		reg = <0x0 0x100>;
		enable-method = "psci";
		clocks = <&kryocc 1>;
		operating-points-v2 = <&cluster1_opp>;
		cooling-min-level = <0>;
		cooling-max-level = <15>;
		#cooling-cells = <2>;
		next-level-cache = <&L2_1>;
		L2_1: l2-cache {
		      compatible = "cache";
		      cache-level = <2>;
		};
	};

	CPU3: cpu@101 {
		device_type = "cpu";
		compatible = "qcom,kryo";
		reg = <0x0 0x101>;
		enable-method = "psci";
		clocks = <&kryocc 1>;
		operating-points-v2 = <&cluster1_opp>;
		cooling-min-level = <0>;
		cooling-max-level = <15>;
		#cooling-cells = <2>;
		next-level-cache = <&L2_1>;
	};

	cpu-map {
		cluster0 {
			core0 {
				cpu = <&CPU0>;
			};

			core1 {
				cpu = <&CPU1>;
			};
		};

		cluster1 {
			core0 {
				cpu = <&CPU2>;
			};

			core1 {
				cpu = <&CPU3>;
			};
		};
	};
};

/*
 * The qcom-cpufreq-kryo driver reads the initial settings in efuse
 * and populates OPPs.
 */
cluster0_opp: opp_table0 {
	compatible = "operating-points-v2-kryo-cpu";
	nvmem-cells = <&speedbin_efuse>;
	opp-shared;

	opp-307200000 {
		opp-hz = /bits/ 64 <  307200000 >;
		opp-microvolt = <905000 905000 1140000>;
		clock-latency-ns = <200000>;
	};
};

/*
 * The qcom-cpufreq-kryo driver reads the initial settings in efuse
 * and populates OPPs.
 */
cluster1_opp: opp_table1 {
	compatible = "operating-points-v2-kryo-cpu";
	nvmem-cells = <&speedbin_efuse>;
	opp-shared;

	opp-307200000 {
		opp-hz = /bits/ 64 <  307200000 >;
		opp-microvolt = <905000 905000 1140000>;
		clock-latency-ns = <200000>;
	};
};

reserved-memory {
	#address-cells = <2>;
	#size-cells = <2>;
	ranges;
....
	smem_mem: smem-mem@86000000 {
		reg = <0x0 0x86000000 0x0 0x200000>;
		no-map;
	};
....
};

smem {
	compatible = "qcom,smem";
	memory-region = <&smem_mem>;
	hwlocks = <&tcsr_mutex 3>;
};

soc {
....
	qfprom: qfprom@74000 {
		compatible = "qcom,qfprom";
		reg = <0x00074000 0x8ff>;
		#address-cells = <1>;
		#size-cells = <1>;
		....
		speedbin_efuse: speedbin@133 {
			reg = <0x133 0x1>;
			bits = <5 3>;
		};
	};
};
```
